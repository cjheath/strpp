## Kconfig
```kconfig
menu "strpp Configuration"

	config STRPP_THREAD_DEFAULT_STACK_BYTES
		int "Default stack size for strpp::Thread (bytes)"
		default 4096
		help
			Used by strpp's Thread class (include/thread.h) whenever a
			Thread is constructed without an explicit
			ThreadParams::stackBytes override. Converted to StackType_t
			words and passed to xTaskCreate() as the usStackDepth
			argument.

	config STRPP_THREAD_DEFAULT_PRIORITY
		int "Default FreeRTOS task priority for strpp::Thread"
		default 1
		range 0 24
		help
			Passed to xTaskCreate() as the uxPriority argument for every
			strpp::Thread (there is currently no per-Thread override for
			this - see include/thread.h).

	config STRPP_MAX_THREAD
		int "Maximum concurrent strpp::Thread instances (0 = unbounded)"
		default 0
		help
			If non-zero, this preallocates the Thread registry (the
			Array<Thread*> in src/thread.cpp) to this capacity once at
			startup, avoiding reallocation and reducing the out-of-memory
			hazard on constrained targets. It is not currently enforced
			as a hard limit. Leave at 0 to let the registry grow
			dynamically instead.

	config STRPP_THREAD_LOCAL_SLOTS
		int "Thread-local storage slots strpp may claim"
		range 1 16
		default 4
		help
			The maximum number of ThreadLocal slots (include/thread_local.h).
			WiFi in ESP32 claims one, and strpp claims two: the error buffer,
			and the thread MessageQueue, and perhaps one more for the
			deadlock/stall monitor, so the default here is 4.
			Each slot costs a pointer in every thread.

	config STRPP_MSGQUEUE_HIGH_WATER
		int "Maximum capacity after which MessageQueue blocks a push"
		range 1 1024
		default 16
		help
			A push to a full queue waits for someone to make room, or
			fails if it has a timeout (include/msgqueue.h). A batch
			push can exceed this limit. If a queue doesn't drain there's
			probably a deadlock. Use the monitor thread to find it.

	config STRPP_MONITOR
		bool "Enable deadlock detection by tracking locks held by each thread"
		default n
		help
			Enable this to allow detecting deadlock and stalls. Keeps track
			of who is holding what, and who is waiting for it. No memory
			cost if disabled, and a small bookkeeping overhead (memory and
			some atomic memory cycles)  when it is enabled. It uses one
			THREAD_LOCAL_SLOT.

	config STRPP_WATCH_THREADS
		int "How many Threads the monitor can see at once"
		depends on STRPP_MONITOR
		range 4 128
		default 32
		help
			The most threads one look at the threads can hold. Each costs
			about 170 bytes of heap in the monitor, and about 40 bytes of
			its stack while it looks. See include/watch.h.

	config STRPP_WATCH_HELD
		int "How many Locks a thread's record can list"
		depends on STRPP_MONITOR
		range 2 32
		default 8
		help
			A thread that holds more locks than this at once is still
			watched, but the extra ones are only counted and cannot take
			part in finding a deadlock. Each costs 16 bytes in every
			thread's record and in every look.

	config STRPP_MONITOR_STACK_BYTES
		int "Stack size for the monitor thread (in bytes)"
		depends on STRPP_MONITOR
		range 3072 16384
		default 6144
		help
			Raise this if you raise the number of threads, queues or
			error buffers: each look keeps an array for them on the stack.
			See include/monitor.h for the sizes.

	config STRPP_MONITOR_QUEUES
		int "How many Queues the monitor can see at once"
		depends on STRPP_MONITOR
		range 4 128
		default 16

	config STRPP_MONITOR_ERRBUFS
		int "How many Error buffers the monitor can see at once"
		depends on STRPP_MONITOR
		range 4 128
		default 16

endmenu
```

## test/freertos_console/sdkconfig.defaults
```kconfig
CONFIG_IDF_TARGET="esp32s3"
CONFIG_ESP_CONSOLE_USB_SERIAL_JTAG=y
CONFIG_FREERTOS_THREAD_LOCAL_STORAGE_POINTERS=5
CONFIG_ESP_MAIN_TASK_STACK_SIZE=6144
CONFIG_FREERTOS_USE_TRACE_FACILITY=y
CONFIG_FREERTOS_USE_STATS_FORMATTING_FUNCTIONS=y
CONFIG_STRPP_MONITOR=y
```
